## sdkconfig.defaults
```kconfig
# Отключаем исключения и RTTI только для C++
CONFIG_COMPILER_CXX_EXCEPTIONS=n
CONFIG_COMPILER_CXX_RTTI=n

# Для ESP32-C6 обязательно включаем PMF (требуется для WPA2/WPA3)
CONFIG_ESP_WIFI_STA_ENABLE_PMF=y
CONFIG_ESP32C6_WIFI_HW_TSF=y
```
